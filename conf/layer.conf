## conf/layer.conf
```bitbake
# We have a conf and classes directory, add to BBPATH
BBPATH .= ":${LAYERDIR}"

# We have recipes-* directories, add to BBFILES
BBFILES += "${LAYERDIR}/recipes-*/*/*.bb \
            ${LAYERDIR}/recipes-*/*/*.bbappend"

BBFILE_COLLECTIONS += "couchdb"
BBFILE_PATTERN_couchdb = "^${LAYERDIR}/"
BBFILE_PRIORITY_couchdb = "5"

LAYERSERIES_COMPAT_couchdb = "zeus dunfell"
```
